## main/Kconfig.projbuild
```kconfig
menu "FTP Server Configuration"

    menu "FTP Server Setting"

        config FTP_USER
            string "FTP User Name"
            default "esp32"
            help
                FTP User name for this Server.

        config FTP_PASSWORD
            string "FTP Password"
            default "esp32"
            help
                FTP Password for this Server.

        config FTP_PASSIVE_PORT
            int "FTP Passive Mode Data Port"
            default 2024
            range 1024 65535
            help
                TCP port for FTP passive mode data connections

        config WIFI_SSID
            string "Wifi SSID"
            default ""
            help
                Wifi SSID.

        config WIFI_PASSWORD
            string "Wifi Password"
            default ""
            help
                Wifi Password.

        config TIMEZONE
            string "Timezone String"
            default "AEST-10"
            help
                POSIX timezone string (e.g., "EST5EDT", "PST8PDT", "CST-8", "UTC0")

                Common examples:
                - US Eastern:    EST5EDT,M3.2.0/2,M11.1.0
                - US Pacific:    PST8PDT,M3.2.0/2,M11.1.0
                - US Central:    CST6CDT,M3.2.0/2,M11.1.0
                - Australia AEST: AEST-10AEDT,M10.1.0,M4.1.0/3
                - UTC:           UTC0
                - China (CST):   CST-8

                See: https://www.gnu.org/software/libc/manual/html_node/TZ-Variable.html

        config SDCARD_MOSI_GPIO
            int "SD Card MOSI GPIO"
            default 11
            range 0 48
            help
                GPIO pin for SD card MOSI signal.

        config SDCARD_MISO_GPIO
            int "SD Card MISO GPIO"
            default 13
            range 0 48
            help
                GPIO pin for SD card MISO signal.

        config SDCARD_SCLK_GPIO
            int "SD Card SCLK GPIO"
            default 12
            range 0 48
            help
                GPIO pin for SD card SCLK signal.

        config SDCARD_CS_GPIO
            int "SD Card CS GPIO"
            default 10
            range 0 48
            help
                GPIO pin for SD card CS (chip select) signal.

    endmenu

endmenu
```

## sdkconfig.defaults
```kconfig
# Target
CONFIG_IDF_TARGET="esp32s3"
CONFIG_IDF_TARGET_ESP32S3=y

# Flash
CONFIG_ESPTOOLPY_FLASHSIZE_16MB=y

# CPU & Performance
CONFIG_ESP32S3_DEFAULT_CPU_FREQ_240=y
CONFIG_ESP32S3_DEFAULT_CPU_FREQ_MHZ=240
CONFIG_FREERTOS_HZ=1000

# PSRAM
CONFIG_SPIRAM=y
CONFIG_SPIRAM_MODE_OCT=y
CONFIG_SPIRAM_SPEED_80M=y
CONFIG_SPIRAM_FETCH_INSTRUCTIONS=y
CONFIG_SPIRAM_RODATA=y
CONFIG_SPIRAM_XIP_FROM_PSRAM=y
CONFIG_ESP32S3_DATA_CACHE_LINE_64B=y

# LVGL
CONFIG_LV_THEME_DEFAULT_DARK=y
CONFIG_LV_OS_FREERTOS=y
CONFIG_LV_FONT_MONTSERRAT_12=y
CONFIG_LV_FONT_MONTSERRAT_16=y
CONFIG_LV_FONT_MONTSERRAT_18=y
CONFIG_LV_FONT_MONTSERRAT_28=y

# Partition Table
CONFIG_PARTITION_TABLE_CUSTOM=y
CONFIG_PARTITION_TABLE_CUSTOM_FILENAME="partitions.csv"
CONFIG_PARTITION_TABLE_FILENAME="partitions.csv"

# ESP System Settings
CONFIG_ESP_SYSTEM_EVENT_TASK_STACK_SIZE=4096
CONFIG_ESP_MAIN_TASK_STACK_SIZE=8192
CONFIG_LWIP_MAX_SOCKETS=10
CONFIG_LWIP_TCP_MSS=1440
CONFIG_LWIP_TCP_SND_BUF_DEFAULT=8192
CONFIG_LWIP_TCP_WND_DEFAULT=8192

# FAT Long Filenames
CONFIG_FATFS_LFN_HEAP=y
CONFIG_FATFS_MAX_LFN=255

# FTP Config
CONFIG_FTP_USER="esp32"
CONFIG_FTP_PASSWORD="esp32"
CONFIG_WIFI_SSID="yourssid"
CONFIG_WIFI_PASSWORD="yourpassword"
CONFIG_TIMEZONE="AEST-10"
```
